## CMakeLists.txt
```
# SPDX-License-Identifier: Apache-2.0

cmake_minimum_required(VERSION 3.20.0)

find_package(Zephyr REQUIRED HINTS $ENV{ZEPHYR_BASE})
project(pyd1598_driver)


add_subdirectory(drivers)


target_sources(app PRIVATE 
    src/main.cpp
)

set(ZEPHYR_CPLUSPLUS ON)
```

## Kconfig
```
# Copyright (c) 2021 Nordic Semiconductor ASA
# SPDX-License-Identifier: Apache-2.0

source "Kconfig.zephyr"

# Search for Kconfig files in the drivers directory
rsource "drivers/Kconfig"
```

## sample.yaml
```
sample:
  description: Test pyd1598 driver
  name: pyd1598
# tests:
#   sample.golioth.pyd1598:
#     harness: pytest
#     tags: golioth socket goliothd
#     timeout: 90
#     extra_args: EXTRA_CONF_FILE="../common/runtime_settings.conf"
#     extra_configs:
#       - CONFIG_SHELL_BACKEND_SERIAL_RX_RING_BUFFER_SIZE=128
#       - CONFIG_SHELL_DEFAULT_TERMINAL_WIDTH=100
#       - CONFIG_GOLIOTH_SAMPLE_NRF91_RESET_LOOP_OVERRIDE=y
#     platform_allow: >
#       esp32_devkitc_wrover
#       mimxrt1024_evk
#       nrf52840dk_nrf52840
#       nrf9160dk_nrf9160_ns
#   sample.golioth.pyd1598.cid:
#     harness: pytest
#     tags: golioth socket goliothd
#     timeout: 90
#     extra_args: EXTRA_CONF_FILE="../common/runtime_settings.conf"
#     extra_configs:
#       - CONFIG_GOLIOTH_USE_CONNECTION_ID=y
#       - CONFIG_SHELL_BACKEND_SERIAL_RX_RING_BUFFER_SIZE=128
#       - CONFIG_SHELL_DEFAULT_TERMINAL_WIDTH=100
#       - CONFIG_GOLIOTH_SAMPLE_NRF91_RESET_LOOP_OVERRIDE=y
#     platform_allow: >
#       esp32_devkitc_wrover
#       mimxrt1024_evk
#       nrf52840dk_nrf52840
#       nrf9160dk_nrf9160_ns
#   sample.golioth.pyd1598.psk:
#     build_only: true
#     platform_allow: >
#       esp32_devkitc_wrover
#       mimxrt1024_evk
#       nrf52840dk_nrf52840
#       qemu_x86
#       nrf9160dk_nrf9160_ns
#   sample.golioth.pyd1598.cert.buildonly:
#     build_only: true
#     extra_configs:
#       - CONFIG_GOLIOTH_AUTH_METHOD_CERT=y
#       # Make it build by providing path that can be resolved
#       - CONFIG_GOLIOTH_SAMPLE_HARDCODED_CRT_PATH="prj.conf"
#       - CONFIG_GOLIOTH_SAMPLE_HARDCODED_KEY_PATH="prj.conf"
#     platform_allow: >
#       esp32_devkitc_wrover
#       mimxrt1024_evk
#       nrf52840dk_nrf52840
#       nrf9160dk_nrf9160_ns
#       qemu_x86
```

## prj.conf
```kconfig
CONFIG_TEST=y

# SERIAL 
CONFIG_SERIAL=y
CONFIG_UART_ASYNC_API=y

# SENSOR
CONFIG_SENSOR=y

# PYD1598
CONFIG_PYD1598=y

# GPIO
CONFIG_GPIO=y

# Remove after development, but make sure to test it afterwards
CONFIG_NO_OPTIMIZATIONS=n
CONFIG_SPEED_OPTIMIZATIONS=y

# Add boot banner to the boot process
CONFIG_BOOT_BANNER=n

CONFIG_CBPRINTF_FP_SUPPORT=y
```

## boards/nrf9160dk_nrf9160_ns.overlay
```dts
/ {

	aliases {
		pir-master = &pyd1598_master;
		pir0 = &pyd1598_0;
	};


	pyd1598_master: pyd1598-master {
		compatible = "excelitas,pyd1598-master";
		pyd1598_0: pyd1598_0 {
			compatible = "excelitas,pyd1598";
			serial_in-gpios = <&gpio0 19 GPIO_ACTIVE_HIGH>;
			direct_link-gpios = <&gpio0 18 GPIO_ACTIVE_HIGH>;
			status = "okay"; // set to "disabled" to disable the sensor
		};

	};
};
```

## dts/bindings/excelitas,pyd1598-master.yaml
```yaml
description: Binding for the pyd1598 sensor.

compatible: "excelitas,pyd1598_master"

include: base.yaml


child-nodes:
    Description: The child nodes of the pyd1598_master node are the pyd1598 nodes.
```

## dts/bindings/excelitas,pyd1598.yaml
```yaml
description: Binding for the pyd1598 sensor.

compatible: "excelitas,pyd1598"

include: base.yaml


properties:
    serial_in-gpios:
        type: phandle-array
        required: true
        description: "GPIO pin for serial input."

    direct_link-gpios:
        type: phandle-array
        required: true
        description: "GPIO pin for direct link."
```

## dts/bindings/vendor-prefixes/excelitas.yaml
```yaml
# excelitas.yaml

description: >
  Vendor prefix for Excelitas Technologies

prefix: excelitas
```

## src/main.cpp
```c
#include <zephyr/logging/log.h>
#include <stdio.h>
#include <zephyr/kernel.h>
#include <zephyr/device.h>
#include <zephyr/pm/device.h>
#include <zephyr/sys/poweroff.h>
#include <soc.h>
#include <hal/nrf_gpio.h>
#include <hal/nrf_regulators.h>
#include <string.h>
#include <zephyr/drivers/gpio.h>
#include <zephyr/devicetree.h>
#include <zephyr/drivers/sensor.h>
#include <pyd1598.h>
#include <errno.h> // std error codes : https://github.com/zephyrproject-rtos/zephyr/blob/main/lib/libc/minimal/include/errno.h
#include <stdint.h>
#include <stdbool.h>
#include <float.h>


LOG_MODULE_REGISTER(main, LOG_LEVEL_DBG);

// Macro to count the number of OKAY children of #master_node
#define COUNT_CHILDREN_OKAY(child) +1
#define NUM_PYD1598_OKAY (0 DT_FOREACH_CHILD_STATUS_OKAY(DT_ALIAS(pir_master), COUNT_CHILDREN_OKAY))



int main(void)
{

    const struct device *devices[NUM_PYD1598_OKAY] = {DT_FOREACH_CHILD_STATUS_OKAY_SEP(DT_ALIAS(pir_master), DEVICE_DT_GET,(,))};
    // * - threshold: 31 (range 0-255)
    // * - blind_time: 6 (0.5 s + 0.5 s * blind_time, range 0-15)
    // * - pulse_counter: 0 (1 + pulse_counter, range 0-3)
    // * - window_time: 0 (2s + 2s * window_time, range 0-3)
    // * - operation_mode: 2 (0: Forced Readout, 1: Interrupt Readout, 2: Wake-up Mode): Only Wake-up Mode is supported
    // * - signal_source: 1 (0: PIR(BRF), 1: PIR(LPF), 2: Not Allowed, 3: Temperature Sensor)
    // * - HPF_Cut_Off: 0 (0: 0.4 Hz, 1: 0.2 Hz)
    // * - Count_Mode: 1 (0: count with (0), or without (1) BPF sign change)


    int ret = 1;
    while (ret != 0)
    {
        ret = pyd1598_set_default_config(devices[0]);
        if (ret != 0)
        {
            LOG_INF("pyd1598_set_default_configuration: %d", ret);
        }
        // Set mode 
        ret = pyd1598_set_operation_mode(devices[0], PYD1598_FORCED_READOUT);
        if (ret != 0)
        {
            LOG_INF("pyd1598_get_operation_mode: %d", ret);
        }
    }


    // Push the configuration to the sensor
    ret = pyd1598_push(devices[0]);
    if (ret != 0)
    {
        LOG_INF("pyd1598_push: %d", ret);
    }


    // Create a float
    float success = 0.5;

    while (true)
    {
    



        // Fetch the data from the sensor
        ret = pyd1598_fetch(devices[0]);
        if (ret != 0)
        {
            success = success*0.99;
        }
        else
        {
        success = success*0.99 + 0.01;
        }


        // Sleep for 10 ms
        k_msleep(10);

        // make float to string
        char success_str[10];
        snprintf(success_str, 10, "%f", success);
        LOG_INF("Success: %s", success_str);







    }





    return 0;
}
```

## src/main copy.cpp
```c
// pyd1598_sensor_array.c

// Define <pyd1598_master> name in device tree

// Get the number of pyd1598 devices in <pyd1598_master> node that are status okay

// Get and save all pyd1598 devices with status okay in <pyd1598_master> node in a struct 

// Make functionality to get the number of pyd1598 devices outside this function

// Interface with pyd1598 devices by index
//  * Configure the device by index
//  * Get the number of devices
//  * Get the configuration of the device
//  * Read the device by index
//  * Reset the device by index
//  * Get the device name by index
//  * Check if any device has been triggerd
//  * Configure all devices


// https://devzone.nordicsemi.com/f/nordic-q-a/100815/out-of-tree-driver---zephyr-freestanding-app
// https://blog.golioth.io/adding-an-out-of-tree-sensor-driver-to-zephyr/
// https://mind.be/zephyr-tutorial-105-writing-a-simple-device-driver/
// https://docs.zephyrproject.org/latest/build/dts/howtos.html#get-devicetree-outputs



#include <zephyr/logging/log.h>
LOG_MODULE_REGISTER(main_module, LOG_LEVEL_DBG); // Use a unique log module name


#include <stdio.h>
#include <zephyr/kernel.h>
#include <zephyr/device.h>
#include <zephyr/pm/device.h>
#include <zephyr/sys/poweroff.h>
#include <soc.h>
#include <hal/nrf_gpio.h>
#include <hal/nrf_regulators.h>
#include <string.h>
#include <zephyr/drivers/gpio.h>
#include <zephyr/devicetree.h>
#include <zephyr/drivers/sensor.h>
#include <pyd1598.h>
// Define which device tree node to use for this driver
/*
* E.g. if it exists pyd1598_master_0, pyd1598_master_1, pyd1598_master_2, ... pyd1598_master_n in the device tree
* and you want to use pyd1598_master_0, set the following line as:
* #define master_node pyd1598_master_0
*/
#define master_node pyd1598_0
// Define master node identifier
#define master_node_identifier DT_NODELABEL(master_node)

// Number of PYD1598 of #master_node
#define COUNT_CHILDREN(child) +1
#define NUM_PYD1598 (0 DT_FOREACH_CHILD(master_node_identifier, COUNT_CHILDREN))


// Macro to count the number of OKAY children of #master_node
#define COUNT_CHILDREN_OKAY(child) +1
#define NUM_PYD1598_OKAY (0 DT_FOREACH_CHILD_STATUS_OKAY(master_node_identifier, COUNT_CHILDREN_OKAY))



// Define a struct to hold the pyd1598 devices
struct master_data_struct
{    
    // Array of pyd1598 devices
    const struct device *pyd1598_devices[NUM_PYD1598_OKAY];
    // Number of pyd1598 devices
    int num_pyd1598_devices;
};


// Define an instance of the struct
// static master_data_struct master_data;
// static const struct device *array_or_childrens[NUM_PYD1598_OKAY] = {DT_FOREACH_CHILD_STATUS_OKAY_SEP(master_node_identifier,DEVICE_DT_GET,(,))};

int main() {
    // static const struct device *array_or_childrens[NUM_PYD1598_OKAY] = {DT_FOREACH_CHILD_STATUS_OKAY_SEP(master_node_identifier,DEVICE_DT_GET,(,))};

    // 
    const struct device *sensor = DEVICE_DT_GET(master_node_identifier);


    while (1)
    {
        /* code */



    }
    
    

    return 0;
}
```
